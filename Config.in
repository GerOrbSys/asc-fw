## package/asc/Config.in
```kconfig
config BR2_PACKAGE_ASC_PACKAGES
  bool "ASC software"
  default y
  help
    Tools, utilities and services for asc operation

source "$BR2_EXTERNAL/package/asc/capture/Config.in"
source "$BR2_EXTERNAL/package/asc/debayer/Config.in"
source "$BR2_EXTERNAL/package/asc/spi/Config.in"
```

## package/asc/capture/Config.in
```kconfig
config BR2_PACKAGE_CAPTURE
	default y
	bool "capture"
	depends on BR2_PACKAGE_ASC_PACKAGES
	help
		Capture application to control the camera
```

## package/asc/debayer/Config.in
```kconfig
config BR2_PACKAGE_DEBAYER
	default y
	bool "debayer"
	depends on BR2_PACKAGE_LIBPNG
	help
		Simple stupid de-bayering application that outputs pngs
```

## package/asc/spi/Config.in
```kconfig
config BR2_PACKAGE_SPI
	default y
	bool "spi"
	depends on BR2_PACKAGE_ASC_PACKAGES
	help
		Application for interacting with on board computer via SPI
```
